## recoil-link/firmware/boards/recoil/recoil_dongle/board.yml
```yaml
board:
  name: recoil_dongle
  full_name: Recoil Link USB Dongle (Nordic PCA10059)
  vendor: recoil
  socs:
    - name: nrf52840
```

## recoil-link/firmware/boards/recoil/recoil_receiver/board.yml
```yaml
board:
  name: recoil_receiver
  full_name: Recoil Link Receiver (nice!nano v2, SoftDevice flash layout)
  vendor: recoil
  socs:
    - name: nrf52840
```

## recoil-link/firmware/boards/recoil/recoil_receiver_nosd/board.yml
```yaml
board:
  name: recoil_receiver_nosd
  full_name: Recoil Link Receiver (nice!nano v2 pinout, no SoftDevice)
  vendor: recoil
  socs:
    - name: nrf52840
```
